## boards/shields/kyria_handwire_v1/Kconfig.shield
```kconfig
config SHIELD_KYRIA_LEFT
    def_bool $(shields_list_contains,kyria_handwire_v1_left)

config SHIELD_KYRIA_RIGHT
    def_bool $(shields_list_contains,kyria_handwire_v1_right)
```

## boards/shields/kyria_handwired_v1/Kconfig.shield
```kconfig
config SHIELD_KYRIA
    bool

config SHIELD_KYRIA_LEFT
    def_bool $(shields_list_contains,kyria_handwire_v1_left)
    select SHIELD_KYRIA

config SHIELD_KYRIA_RIGHT
    def_bool $(shields_list_contains,kyria_handwire_v1_right)
    select SHIELD_KYRIA
```

## boards/shields/try_02/Kconfig.defconfig
```kconfig
if SHIELD_TRY_02_LEFT

config ZMK_KEYBOARD_NAME
    default "Try 02"

config ZMK_SPLIT_ROLE_CENTRAL
    default y

endif

if SHIELD_TRY_02_LEFT || SHIELD_TRY_02_RIGHT

config ZMK_SPLIT
    default y

endif
```

## boards/shields/try_02/Kconfig.shield
```kconfig
config SHIELD_TRY_02_LEFT
    def_bool $(shields_list_contains,try_02_left)

config SHIELD_TRY_02_RIGHT
    def_bool $(shields_list_contains,try_02_right)
```

## boards/shields/v01/Kconfig.defconfig
```kconfig
if SHIELD_V01_LEFT

config ZMK_KEYBOARD_NAME
    default "01"

config ZMK_SPLIT_ROLE_CENTRAL
    default y
endif

if SHIELD_V01_LEFT || SHIELD_V01_RIGHT

config ZMK_SPLIT
    default y
endif
```

## boards/shields/v01/Kconfig.shield
```kconfig
config SHIELD_V01_LEFT
    def_bool $(shields_list_contains,v01_left)

config SHIELD_V01_RIGHT
    def_bool $(shields_list_contains,v01_right)

config SHIELD_V01_NICEVIEW_CS
    def_bool $(shields_list_contains,v01_niceview_cs)
```
